## firmware/main/Kconfig.projbuild
```kconfig
menu "OpenLine beltpack"

choice OPENLINE_DISPLAY
    prompt "Display"
    default OPENLINE_DISPLAY_SSD1309
    config OPENLINE_DISPLAY_SSD1309
        bool "2.42in 128x64 OLED (SSD1309, I2C) - fits the rev D case"
    config OPENLINE_DISPLAY_SH1106
        bool "1.3in 128x64 OLED (SH1106, I2C) - cheapest"
    config OPENLINE_DISPLAY_SSD1306
        bool "0.96in 128x64 OLED (SSD1306, I2C)"
    config OPENLINE_DISPLAY_SSD1680
        bool "2.13in 250x122 e-ink (SSD1680, SPI) - daylight readable, experimental"
endchoice

choice OPENLINE_CODEC_CLOCK
    prompt "Codec clock"
    default OPENLINE_CODEC_XTAL
    help
        How the WM8960 gets its master clock. Look at your codec board: if it has
        a pin labelled MCLK, either works; if it has no MCLK pin (SparkFun
        BOB-21250 and its clones carry a 24 MHz crystal), choose the crystal.
    config OPENLINE_CODEC_XTAL
        bool "Codec's own 24 MHz crystal (SparkFun BOB-21250 and clones)"
    config OPENLINE_CODEC_MCLK
        bool "ESP32 drives MCLK on GPIO 38"
endchoice

config OPENLINE_ETHERNET
    bool "W5500 Ethernet / PoE fitted"
    default y

config OPENLINE_OLED_FLIP
    bool "Rotate OLED 180 degrees"
    depends on !OPENLINE_DISPLAY_SSD1680
    default n
    help
        Turn this on if the text comes out upside down for the wearer.

config OPENLINE_EPD_FLIP
    bool "Rotate e-ink display 180 degrees"
    depends on OPENLINE_DISPLAY_SSD1680
    default n

endmenu
```

## firmware/sdkconfig.defaults
```kconfig
# OpenLine beltpack (ESP32-S3-WROOM-1-N16R8)
CONFIG_IDF_TARGET="esp32s3"
CONFIG_ESPTOOLPY_FLASHSIZE_16MB=y
CONFIG_PARTITION_TABLE_CUSTOM=y
CONFIG_PARTITION_TABLE_CUSTOM_FILENAME="partitions.csv"
CONFIG_SPIRAM=y
CONFIG_SPIRAM_MODE_OCT=y
CONFIG_SPIRAM_SPEED_80M=y
CONFIG_SPIRAM_USE_MALLOC=y
CONFIG_ESP_DEFAULT_CPU_FREQ_MHZ_240=y
CONFIG_FREERTOS_HZ=1000
# console on the USB-C port (frees UART0 pins for the display)
CONFIG_ESP_CONSOLE_USB_SERIAL_JTAG=y
# Bluetooth LE (NimBLE) + Wi-Fi coexistence
CONFIG_BT_ENABLED=y
CONFIG_BT_NIMBLE_ENABLED=y
CONFIG_BT_NIMBLE_MAX_CONNECTIONS=1
CONFIG_BT_NIMBLE_ATT_PREFERRED_MTU=247
CONFIG_BT_NIMBLE_ROLE_CENTRAL=n
CONFIG_BT_NIMBLE_ROLE_OBSERVER=n
CONFIG_ESP_COEX_SW_COEXIST_ENABLE=y
# Wi-Fi tuned for low latency
CONFIG_ESP_WIFI_STATIC_RX_BUFFER_NUM=10
CONFIG_ESP_WIFI_DYNAMIC_RX_BUFFER_NUM=32
CONFIG_ESP_WIFI_AMPDU_TX_ENABLED=n
CONFIG_ESP_WIFI_AMPDU_RX_ENABLED=n
CONFIG_LWIP_TCP_NODELAY=y
# Ethernet (W5500 over SPI, PoE variant)
CONFIG_ETH_USE_SPI_ETHERNET=y
CONFIG_ETH_SPI_ETHERNET_W5500=y
# TLS to Let's Encrypt etc.
CONFIG_MBEDTLS_CERTIFICATE_BUNDLE=y
CONFIG_MBEDTLS_CERTIFICATE_BUNDLE_DEFAULT_FULL=y
CONFIG_MBEDTLS_EXTERNAL_MEM_ALLOC=y
CONFIG_ESP_MAIN_TASK_STACK_SIZE=8192
```
